/dts-v1/;

/ {
    ATTR_FAPI_NAME = "k0";
    ATTR_HWAS_STATE = [ 00 00 00 00 00 ];
    ATTR_PHYS_BIN_PATH = [ 21 01 00 00 00 00 00 00 00 00 00 00 00 00 00 00 00 00 00 00 00 ];
    ATTR_PHYS_DEV_PATH = "physical:sys-0";
    ATTR_TYPE = [ 01 ];
    ATTR_CLASS = [ 01 ];
    node0 {
        compatible = "ibm,power-node";
        index = <0x00>;
        ATTR_FAPI_NAME = "pu:k0:n0";
        ATTR_HWAS_STATE = [ 00 00 00 00 00 ];
        ATTR_PHYS_BIN_PATH = [ 22 01 00 02 00 00 00 00 00 00 00 00 00 00 00 00 00 00 00 00 00 ];
        ATTR_PHYS_DEV_PATH = "physical:sys-0/node-0";
        ATTR_TYPE = [ 02 ];
        ATTR_CLASS = [ 02 ];

        proc0 {
            compatible = "ibm,power-proc", "ibm,power10-proc";
            index = <0x00>;
            ATTR_FAPI_NAME = "pu:k0:n0:p00";
            ATTR_HWAS_STATE = [ 00 00 00 00 00 ];
            ATTR_LOCATION_CODE = "Ufcs-P0-C15";
            ATTR_PHYS_BIN_PATH = [ 23 01 00 02 00 05 00 00 00 00 00 00 00 00 00 00 00 00 00 00 00 ];
            ATTR_PHYS_DEV_PATH = "physical:sys-0/node-0/proc-0";
            ATTR_TYPE = [ 05 ];
            ATTR_CLASS = [ 05 ];
        };
    };
};
